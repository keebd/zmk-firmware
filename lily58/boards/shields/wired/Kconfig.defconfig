## lily58/boards/shields/wired/Kconfig.defconfig
```kconfig
if SHIELD_WIRED

# Inter-half comms go over the wire, not BLE. Host connectivity (USB/BLE)
# is unaffected. Only one split transport can be active per build.
config ZMK_SPLIT_BLE
    default n

endif
```

## yampad/west.yml
```yaml
manifest:
  remotes:
    - name: zmkfirmware
      url-base: https://github.com/zmkfirmware
  projects:
    - name: zmk
      remote: zmkfirmware
      # Pinned to a known-good zmkfirmware/zmk commit on main (Zephyr 4.1).
      # Bumped via Renovate (see /renovate.json) so upgrades arrive as reviewable PRs.
      revision: 64daf698e073e37b6748ac54f4eb48d8666af0b9
      import: app/west.yml
  self:
    path: config
```
